## Kconfig
```kconfig
menu "HyperRTLS"

choice HRTLS_TARGET
    prompt "App target selection"
    default HRTLS_TARGET_ANCHOR

    config HRTLS_TARGET_ANCHOR
        bool "Anchor"

    config HRTLS_TARGET_GW
        bool "Gateway"

    config HRTLS_TARGET_TAG
        bool "TAG"
endchoice

if HRTLS_TARGET_ANCHOR || HRTLS_TARGET_TAG
    config HRTLS_PAN_ID
        hex "PAN ID"
        range 0x0 0xFFFF
        default 0xDECA

    config HRTLS_UWB_ADDR
        hex "UWB addr"
        range 0x0 0xFFFF
        default 0 if HRTLS_TARGET_TAG
        default 1 if HRTLS_TARGET_ANCHOR
endif

endmenu

source "Kconfig.zephyr"
```

## boards/qemu_x86_gw.conf
```kconfig
### Networking
CONFIG_PCIE=y
CONFIG_ETH_E1000=y

CONFIG_NET_CONFIG_SETTINGS=y
CONFIG_NET_CONFIG_NEED_IPV4=y
CONFIG_NET_CONFIG_MY_IPV4_ADDR="192.0.2.1"
CONFIG_NET_CONFIG_MY_IPV4_GW="192.0.2.2"
CONFIG_NET_CONFIG_MY_IPV4_NETMASK="255.255.0.0"
CONFIG_NET_L2_ETHERNET=y
CONFIG_NET_QEMU_ETHERNET=y
```

## west.yml
```yaml
manifest:
  remotes:
  - name: zephyrproject-rtos
    url-base: https://github.com/zephyrproject-rtos
  projects:
  - name: zephyr
    path: zephyr
    remote: zephyrproject-rtos
    revision: v3.1.0
    import: true
  - name: zscilib
    path: modules/lib/zscilib
    remote: zephyrproject-rtos
    revision: fc979a8dcb74169c69b02835927bff8f070d6325
```
